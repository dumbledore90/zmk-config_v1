#include "oyayubi_01.dtsi"
// Re-enable when switching back to ZMK main for trackpad support:
// #include <input/processors.dtsi>
// #include <dt-bindings/pinctrl/nrf-pinctrl.h>

// 左手 (central) の GPIO アサイン
// ピン番号の出典: docs/xiao_gpio_map_v2.md
// &xiao_d は D11 以降未定義のため使わず、全ピン &gpio0/&gpio1 で直接指定

&kscan {
    row-gpios =
        <&gpio0 2  (GPIO_ACTIVE_HIGH | GPIO_PULL_DOWN)>,  // Row0 / D0  / P0.02
        <&gpio1 15 (GPIO_ACTIVE_HIGH | GPIO_PULL_DOWN)>,  // Row1 / D10 / P1.15
        <&gpio1 14 (GPIO_ACTIVE_HIGH | GPIO_PULL_DOWN)>,  // Row2 / D9  / P1.14
        <&gpio1 13 (GPIO_ACTIVE_HIGH | GPIO_PULL_DOWN)>,  // Row3 / D8  / P1.13
        <&gpio1 12 (GPIO_ACTIVE_HIGH | GPIO_PULL_DOWN)>;  // Row4 / D7  / P1.12

    col-gpios =
        <&gpio0 15 GPIO_ACTIVE_HIGH>,  // Col0 / D11 / P0.15
        <&gpio0 3  GPIO_ACTIVE_HIGH>,  // Col1 / D1  / P0.03
        <&gpio0 28 GPIO_ACTIVE_HIGH>,  // Col2 / D2  / P0.28
        <&gpio0 29 GPIO_ACTIVE_HIGH>,  // Col3 / D3  / P0.29
        <&gpio0 4  GPIO_ACTIVE_HIGH>,  // Col4 / D4  / P0.04
        <&gpio0 5  GPIO_ACTIVE_HIGH>,  // Col5 / D5  / P0.05
        <&gpio1 11 GPIO_ACTIVE_HIGH>;  // Col6 / D6  / P1.11
};

// ── トラックパッド IQS7211E (I2C) ────────────────────────────────────────────
// IQS7211E driver requires ZMK main (Zephyr 4.1).
// BLE Management requires cormoran fork (v0.3). Re-enable when switching back to main.
//
// SCL = D12 / P0.19   SDA = D13 / P1.01   RDY = D17 / P1.03
//
// &pinctrl {
//     i2c0_default: i2c0_default {
//         group1 {
//             psels = <NRF_PSEL(TWIM_SDA, 1, 1)>,   // P1.01 = D13
//                     <NRF_PSEL(TWIM_SCL, 0, 19)>;   // P0.19 = D12
//             bias-pull-up;
//         };
//     };
//     i2c0_sleep: i2c0_sleep {
//         group1 {
//             psels = <NRF_PSEL(TWIM_SDA, 1, 1)>,   // P1.01 = D13
//                     <NRF_PSEL(TWIM_SCL, 0, 19)>;   // P0.19 = D12
//             low-power-enable;
//         };
//     };
// };
//
// &i2c0 {
//     status = "okay";
//     pinctrl-0 = <&i2c0_default>;
//     pinctrl-1 = <&i2c0_sleep>;
//     pinctrl-names = "default", "sleep";
//     clock-frequency = <400000>;
//
//     iqs7211e: iqs7211e@56 {
//         compatible = "azoteq,iqs7211e";
//         reg = <0x56>;
//         // TODO: 要実機検証。D17/D19 物理パッド逆転の可能性あり。
//         // 無反応の場合は &gpio1 7 (P1.07 = D19) に変更する。
//         irq-gpios = <&gpio1 3 (GPIO_ACTIVE_LOW | GPIO_PULL_UP)>;  // RDY / D17 / P1.03
//         single-tap = <0>;  // BTN_0 = 左クリック
//     };
// };
//
// / {
//     trackpad_input_listener: trackpad_input_listener {
//         compatible = "zmk,input-listener";
//         status = "okay";
//         device = <&iqs7211e>;
//         input-processors = <&zip_xy_scaler 1 1>;
//     };
// };
